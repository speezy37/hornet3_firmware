#include <Servo.h>

static unsigned char auchCRCHi[] = {
  0x00, 0xC1, 0x81, 0x40, 0x01, 0xC0, 0x80, 0x41, 0x01, 0xC0, 0x80, 0x41, 0x00, 0xC1, 0x81, 0x40, 
  0x01, 0xC0, 0x80, 0x41, 0x00, 0xC1, 0x81, 0x40, 0x00, 0xC1, 0x81, 0x40, 0x01, 0xC0, 0x80, 0x41, 
  0x01, 0xC0, 0x80, 0x41, 0x00, 0xC1, 0x81, 0x40, 0x00, 0xC1, 0x81, 0x40, 0x01, 0xC0, 0x80, 0x41, 
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  0x00, 0xC1, 0x81, 0x40, 0x01, 0xC0, 0x80, 0x41, 0x01, 0xC0, 0x80, 0x41, 0x00, 0xC1, 0x81, 0x40
} ; 

static char auchCRCLo[] = {
  0x00, 0xC0, 0xC1, 0x01, 0xC3, 0x03, 0x02, 0xC2, 0xC6, 0x06, 0x07, 0xC7, 0x05, 0xC5, 0xC4, 0x04, 
  0xCC, 0x0C, 0x0D, 0xCD, 0x0F, 0xCF, 0xCE, 0x0E, 0x0A, 0xCA, 0xCB, 0x0B, 0xC9, 0x09, 0x08, 0xC8, 
  0xD8, 0x18, 0x19, 0xD9, 0x1B, 0xDB, 0xDA, 0x1A, 0x1E, 0xDE, 0xDF, 0x1F, 0xDD, 0x1D, 0x1C, 0xDC, 
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  0x44, 0x84, 0x85, 0x45, 0x87, 0x47, 0x46, 0x86, 0x82, 0x42, 0x43, 0x83, 0x41, 0x81, 0x80, 0x40
} ;

#define ADDRESS 0x01
#define BAUD_RATE    19200
#define TIMEOUT      5


#define PIN_T_ONE    5
#define PIN_T_TWO    6
#define PIN_T_THREE  10
#define PIN_T_FOUR   11
#define PIN_T_FIVE   9

#define SERVO_GRAB   12
#define SERVO_DROP   4

#define PIN_RS485    2

struct{
  short t1Value = 0x05dc;
  short t2Value = 0x05dc;
  short t3Value = 0x05dc;
  short t4Value = 0x05dc;
  short t5Value = 0x05dc;
  short s1Value = 0x0000;
  short s2Value = 0x0000;
} Register;

unsigned short CRC16(
  unsigned char *puchMsg,           /* message to calculate CRC upon */
  unsigned short usDataLen          /* quantity of bytes in message */
){
  unsigned char uchCRCHi = 0xFF ;   /* high byte of CRC initialized */
  unsigned char uchCRCLo = 0xFF ;   /* low byte of CRC initialized */
  unsigned uIndex ;                 /* will index into CRC lookup table */
  
  while (usDataLen--)
  {
    uIndex = uchCRCHi ^ *puchMsg++;	/* calculate the CRC */
    uchCRCHi = uchCRCLo ^ auchCRCHi[uIndex];
    uchCRCLo = auchCRCLo[uIndex];
  }
  
  return (uchCRCHi << 8 | uchCRCLo);
}

void sendReply(byte data[], int len){
  digitalWrite(PIN_RS485, HIGH);
  
  //return frame
  Serial.write(data, len);
  Serial.flush();
  
  digitalWrite(PIN_RS485, LOW);
}

Servo thrust1, thrust2, thrust3, thrust4, thrust5, servoGrab, servoDrop;

void setup() {
  Serial.begin(BAUD_RATE);
  Serial.setTimeout(TIMEOUT);
  pinMode(PIN_RS485, OUTPUT);
  digitalWrite(PIN_RS485, LOW);

  thrust1.attach(PIN_T_ONE);
  thrust2.attach(PIN_T_TWO);
  thrust3.attach(PIN_T_THREE);
  thrust4.attach(PIN_T_FOUR);
  thrust5.attach(PIN_T_FIVE);

  servoDrop.attach(SERVO_DROP);
  servoGrab.attach(SERVO_GRAB); 
  
  thrust1.writeMicroseconds(1500);
  thrust2.writeMicroseconds(1500);
  thrust3.writeMicroseconds(1500);
  thrust4.writeMicroseconds(1500);
  thrust5.writeMicroseconds(1500);
  delay(500);
}

void loop() {
  thrust1.writeMicroseconds(Register.t1Value);
  thrust2.writeMicroseconds(Register.t2Value); 
  thrust3.writeMicroseconds(Register.t3Value);
  thrust4.writeMicroseconds(Register.t4Value); 
  thrust5.writeMicroseconds(Register.t5Value);
  servoGrab.write(Register.s1Value);
  servoDrop.write(Register.s2Value);
}

void serialEvent() {
  byte buf[50];  
  short len = Serial.readBytes(buf, 50);
  short *pointer = &Register.t1Value;
  
  byte addrBuf = buf[0];

  //correct address
  if(addrBuf == ADDRESS){
    short crcBuf = (buf[len - 2] << 8 | buf[len - 1]);
    short crcData = CRC16(buf, len - 2);

    //correct CRC
    if(crcBuf == crcData){
      //function code
      byte funcBuf = buf[1];
      
      //write single register
      if(funcBuf == 0x06){
        //first register
        short regBuf = buf[2] << 8 | buf[3];

        //illegal data address
        if(regBuf > 6){
		  byte errorBuf[5] = {0x01, 0x86, 0x02, 0xC3, 0xA1};
          //format error reply
          sendReply(errorBuf, 5);
        }
        //correct data address
        else{
          pointer += regBuf;
          *pointer = (buf[4] << 8 | buf[5]);
          
          //format reply
          sendReply(buf, len);
        }      
      }
      //write multiple register
      else if(funcBuf == 0x10){
        //first register
        short regBuf = buf[2] << 8 | buf[3];
        
        //number of registers
        short numReg = buf[4] << 8 | buf[5];

        //number of data bytes
        byte numData = buf[6];

        for(int i = 0; i < numReg; i++){
          
        }
      }
      //wrong function
      else{
        byte response[5];

        response[0] = buf[0];
        response[1] = buf[1] + 0x80;
        response[2] = 0x01;

        crcData = CRC16(response, 3);
        response[3] = crcData >> 8;
        response[4] = crcData & 0x0FF;

        //format error reply
        sendReply(response, 5);
      }
    }
  }
}

