#include <Wire.h>
#include <Servo.h>
#include "I2Cdev.h"
#include "MPU6050.h"
#include "HMC5883L.h"
#include "MS5837.h"

static unsigned char auchCRCHi[] = {
  0x00, 0xC1, 0x81, 0x40, 0x01, 0xC0, 0x80, 0x41, 0x01, 0xC0, 0x80, 0x41, 0x00, 0xC1, 0x81, 0x40, 
  0x01, 0xC0, 0x80, 0x41, 0x00, 0xC1, 0x81, 0x40, 0x00, 0xC1, 0x81, 0x40, 0x01, 0xC0, 0x80, 0x41, 
  0x01, 0xC0, 0x80, 0x41, 0x00, 0xC1, 0x81, 0x40, 0x00, 0xC1, 0x81, 0x40, 0x01, 0xC0, 0x80, 0x41, 
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  0x00, 0xC1, 0x81, 0x40, 0x01, 0xC0, 0x80, 0x41, 0x01, 0xC0, 0x80, 0x41, 0x00, 0xC1, 0x81, 0x40
} ; 

static char auchCRCLo[] = {
  0x00, 0xC0, 0xC1, 0x01, 0xC3, 0x03, 0x02, 0xC2, 0xC6, 0x06, 0x07, 0xC7, 0x05, 0xC5, 0xC4, 0x04, 
  0xCC, 0x0C, 0x0D, 0xCD, 0x0F, 0xCF, 0xCE, 0x0E, 0x0A, 0xCA, 0xCB, 0x0B, 0xC9, 0x09, 0x08, 0xC8, 
  0xD8, 0x18, 0x19, 0xD9, 0x1B, 0xDB, 0xDA, 0x1A, 0x1E, 0xDE, 0xDF, 0x1F, 0xDD, 0x1D, 0x1C, 0xDC, 
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  0x44, 0x84, 0x85, 0x45, 0x87, 0x47, 0x46, 0x86, 0x82, 0x42, 0x43, 0x83, 0x41, 0x81, 0x80, 0x40
} ;

#define ADDRESS   0x02
#define RS485PIN  2

#define BAUD_RATE	19200
#define TIMEOUT		5

#define PRESSURE_INTERVAL	500
#define ACCEL_GYRO_INTERVAL	40
#define MAG_INTERVAL		40
#define DEPTH_INTERVAL		100

// register list
struct {
  short raxHi;
  short raxLo;
  
  short rayHi;
  short rayLo;
  
  short razHi;
  short razLo;

  short rgxHi;
  short rgxLo;
  
  short rgyHi;
  short rgyLo;
  
  short rgzHi;
  short rgzLo;
  
  short mx;
  short my;
  short mz;

  short pressureHi;
  short pressureLo;

  short depthHi;
  short depthLo;
  
} Data ;

// 16 bit CRC value for modbus
unsigned short CRC16(
  unsigned char *puchMsg,           /* message to calculate CRC upon */
  unsigned short usDataLen          /* quantity of bytes in message */
){
  unsigned char uchCRCHi = 0xFF ;   /* high byte of CRC initialized */
  unsigned char uchCRCLo = 0xFF ;   /* low byte of CRC initialized */
  unsigned uIndex ;                 /* will index into CRC lookup table */
  
  while (usDataLen--)
  {
    uIndex = uchCRCHi ^ *puchMsg++; /* calculate the CRC */
    uchCRCHi = uchCRCLo ^ auchCRCHi[uIndex];
    uchCRCLo = auchCRCLo[uIndex];
  }
  
  return (uchCRCHi << 8 | uchCRCLo);
}

// convert float to 4 byte format
union {
  unsigned long bite;
  float data;
} extract;

// store float data to registers
void storeFloat(float input, short *pointer){
  extract.data = input;
  *pointer = extract.bite >> 16;
  
  pointer++;
  *pointer = extract.bite & 0x0FFFF;
}

// convert accel reading to true value
float convertRawAccel(int16_t raw) {
  return 2.0f*(float)raw/32768.0f;
}
// conver gyro reading to true value
float convertRawGyr(int16_t raw) {
  return 500.0f*(float)raw/32768.0f;
}

// initialisation
HMC5883L mag;
MPU6050 accelgyro;
MS5837 sensor;

unsigned long pressureTime, accelGyroTime, magTime, depthTime;

void setup() {
  // initialize communication bus
  Wire.begin();
  Serial.begin(BAUD_RATE);
  Serial.setTimeout(TIMEOUT);

  // set RS485 to read mode
  pinMode(RS485PIN, OUTPUT);
  digitalWrite(RS485PIN, LOW);

  // initialize magnetometer
  mag.initialize();

  // initialize accelerometer and gyroscope
  accelgyro.initialize();
  accelgyro.setI2CBypassEnabled(true);
  accelgyro.setFullScaleGyroRange(MPU6050_GYRO_FS_500);
  accelgyro.setFullScaleAccelRange(MPU6050_ACCEL_FS_2);
  
  // initialize depth sensor
  sensor.init();
  sensor.setFluidDensity(997);
  
  // sync time for reading
  accelGyroTime = pressureTime = magTime = depthTime = millis();
}

void loop(){
  unsigned long milliNow = millis();
  
  // depth sensor
  // if (milliNow - depthTime >= DEPTH_INTERVAL) {
	
	// depthTime += DEPTH_INTERVAL;
  // }
  
  // Accelerometer & Gyroscope
  if (milliNow - accelGyroTime >= ACCEL_GYRO_INTERVAL) {
    short ax, ay, az, gx, gy, gz;
    accelgyro.getMotion6(&ax, &ay, &az, &gx, &gy, &gz);

	// convert & store accelerometer readings
    storeFloat(convertRawAccel(ax), &Data.raxHi);    
    storeFloat(convertRawAccel(ay), &Data.rayHi);
    storeFloat(convertRawAccel(az), &Data.razHi);  

	// convert & store gyroscope readings
    storeFloat(convertRawGyr(gx), &Data.rgxHi);
    storeFloat(convertRawGyr(gy), &Data.rgyHi);
    storeFloat(convertRawGyr(gz), &Data.rgzHi);

    accelGyroTime += ACCEL_GYRO_INTERVAL;  
  }
  
  // Magnetometer
  else if (milliNow - magTime >= MAG_INTERVAL) {
    mag.getHeading(&Data.mx, &Data.my, &Data.mz);
    magTime += MAG_INTERVAL;
  }
  
  // Pressure Sensor  
  else if((milliNow - pressureTime) > PRESSURE_INTERVAL){
    float vOut = 3.3 * analogRead(A0) / 1023;
    float vIn = 3.3 * analogRead(A1) / 1023;
    float pressure = 0.01 * (vOut / vIn + 0.48571) / 0.00876;

    storeFloat(pressure, &Data.pressureHi);
    pressureTime += PRESSURE_INTERVAL;
  } 
} // end of main loop

// serial for modbus
void serialEvent() {
  uint8_t buf[50];
  uint8_t len = Serial.readBytes(buf, 50);
  short *pointer = &Data.raxHi;

  byte addrBuf = buf[0];

  //correct address
  if(addrBuf == ADDRESS) {
    short crcBuf = (buf[len - 2] << 8 | buf[len - 1]);
    short crcData = CRC16(buf, len - 2);

    //correct CRC
    if(crcBuf == crcData) {
      //function code
      byte funcBuf = buf[1];

      //register
      short regBuf = buf[2] << 8 | buf[3];

      if(funcBuf == 0x03) { // read function
        pointer += regBuf;
        short lenBuf = buf[5] * 2;

        uint8_t outBuf[50];
        outBuf[0] = buf[0];
        outBuf[1] = buf[1];
        outBuf[2] = lenBuf;

        for(int i=0; i < lenBuf; i += 2) {
          outBuf[3+i] = *pointer >> 8;
          outBuf[4+i] = *pointer & 0x0FF;
          pointer++;
        }

        crcData = CRC16(outBuf, lenBuf+3);
        outBuf[3+lenBuf] = crcData >> 8;
        outBuf[4+lenBuf] = crcData & 0x0FF;

        digitalWrite(RS485PIN, HIGH);
	
        //return frame
        Serial.write(outBuf, 5+lenBuf);
        Serial.flush();

        digitalWrite(RS485PIN, LOW);
      }        
    }
  }
}
